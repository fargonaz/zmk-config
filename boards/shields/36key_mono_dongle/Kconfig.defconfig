## boards/shields/36key_mono_dongle/Kconfig.defconfig
```kconfig
#if SHIELD_CORNE_LEFT || SHIELD_CORNE_RIGHT || SHIELD_CORNE_LEFT_PERIPHERAL || SHIELD_CORNE_DONGLE_PRO_MICRO


if SHIELD_DONGLE

#  config ZMK_KEYBOARD_NAME
#   default "DONGLE"
   config ZMK_KEYBOARD_NAME
    default "MONO36"

  config ZMK_SPLIT_ROLE_CENTRAL
    default y

  config ZMK_USB
    default y

endif # ZMK_DISPLAY

if SHIELD_MONO36 || SHIELD_DONGLE

config ZMK_SPLIT
    default y

config ZMK_BLE
    default y

endif
```

## boards/shields/36key_mono_dongle/Kconfig.shield
```kconfig
# Copyright (c) 2020 Pete Johanson
# SPDX-License-Identifier: MIT

config SHIELD_MONO36
    def_bool $(shields_list_contains,mono36)

config SHIELD_DONGLE
    def_bool $(shields_list_contains,dongle)
```

## boards/shields/studio/Kconfig.defconfig
```kconfig
# Copyright (c) 2023 The ZMK Contributors
# SPDX-License-Identifier: MIT

if SHIELD_STUDIO

config ZMK_KEYBOARD_NAME
    default "STUDIO"

config ZMK_BLE
    default y
config ZMK_USB
    default y

endif
```

## boards/shields/studio/Kconfig.shield
```kconfig
# Copyright (c) 2023 The ZMK Contributors
# SPDX-License-Identifier: MIT

config SHIELD_STUDIO
    def_bool $(shields_list_contains,studio)
```
